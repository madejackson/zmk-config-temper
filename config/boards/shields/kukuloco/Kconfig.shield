## config/boards/shields/kukuloco/Kconfig.shield
```kconfig
config SHIELD_KUKULOCO_LEFT
    def_bool $(shields_list_contains,kukuloco_left)

config SHIELD_KUKULOCO_RIGHT
    def_bool $(shields_list_contains,kukuloco_right)
```
